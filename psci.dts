/dts-v1/;
/plugin/;

/ {
    compatible = "brcm,bcm2835", "brcm,bcm2708", "brcm,bcm2709";
    fragment@0 {
        target-path = "/";
        __overlay__ {
            psci {
                compatible      = "arm,psci-0.2";
                method          = "smc";
            };
        };
    };
};
